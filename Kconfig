## Kconfig
```kconfig
menu "My Device Drivers"

config MYDRIVERS
	bool "mydrivers examples"

if MYDRIVERS
config MYDRIVERS_HELLOWORLD
	tristate "hello world"

config MYDRIVERS_MODULEPARAM
	tristate "moduleparam"
	help
	  a simple module param example

config MYDRIVERS_CHARDEV
	tristate "chardev"
	help
	  a simple chardev example

config MYDRIVERS_PROCFS
	tristate "procfs"
	help
	  a simple module procfs example

config MYDRIVERS_TIMER
	tristate "timer"
	help
	  a simple timer module example

config MYDRIVERS_GLOBALMEM
	tristate "globalmem"
	help
	  a simple char device driver

config MYDRIVERS_VMEMDISK
	tristate "vmem_disk"
	help
	  a simple block device driver
endif

endmenu
```

## mydrivers/Kconfig
```kconfig
menu "My Device Drivers"

config MYDRIVERS
	bool "mydrivers examples"

if MYDRIVERS
config MYDRIVERS_HELLOWORLD
	tristate "hello world"

config MYDRIVERS_MODULE_PARAM
	tristate "moduleparam"
	help
	  a simple module param example

config MYDRIVERS_GLOBALMEM
	tristate "globalmem"
	help
	  a simple char device driver

config MYDRIVERS_VMEMDISK
	tristate "vmem_disk"
	help
	  a simple block device driver
endif

endmenu
```
